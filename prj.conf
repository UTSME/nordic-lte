## CMakeLists.txt
```
cmake_minimum_required(VERSION 3.20.0)
find_package(Zephyr REQUIRED HINTS $ENV{ZEPHYR_BASE})

project(lte_m)

target_sources(app PRIVATE src/main.c)

zephyr_include_directories(src)

target_sources(app PRIVATE src/lte_m_udp_connection.c)
target_sources(app PRIVATE src/lte_m_udp_send_receive.c)
```

## Kconfig
```
menu "lte_m udp settings"

config UDP_SERVER_ADDRESS_STATIC
	string "UDP server IP address"
	default "8.8.8.8"

config UDP_SERVER_PORT
	int "UDP server port number"
	default "2469"

config UDP_PSM_ENABLE
	bool "Enable LTE Power Saving Mode (PSM)"
	default y
	select LTE_PSM_REQ

config UDP_EDRX_ENABLE
	bool "Enable LTE enhanced Discontinuous Reception (eDRX)"
	select LTE_EDRX_REQ

endmenu

# module = UDP
# module-str = UDP sample
# source "${ZEPHYR_BASE}/subsys/logging/Kconfig.template.log_config"

menu "Zephyr Kernel"
source "Kconfig.zephyr"
endmenu
```

## prj.conf
```kconfig
# General config
CONFIG_PICOLIBC_IO_FLOAT=y
CONFIG_NCS_SAMPLES_DEFAULTS=y
CONFIG_SERIAL=y

# Network
CONFIG_NETWORKING=y
CONFIG_NET_NATIVE=n
CONFIG_NET_SOCKETS=y
CONFIG_NET_SOCKETS_OFFLOAD=y

CONFIG_UDP_SERVER_ADDRESS_STATIC="203.164.243.56"
CONFIG_UDP_SERVER_PORT=45000
CONFIG_UDP_DATA_UPLOAD_SIZE_BYTES=5
# CONFIG_UDP_RAI_ENABLE=y

# LTE link control
CONFIG_LTE_LINK_CONTROL=y

# Modem library
CONFIG_NRF_MODEM_LIB=y

# Heap and stacks
CONFIG_HEAP_MEM_POOL_SIZE=1024
CONFIG_MAIN_STACK_SIZE=4096
CONFIG_SYSTEM_WORKQUEUE_STACK_SIZE=2048

# LTE parameters
## PSM
CONFIG_UDP_PSM_ENABLE=y
CONFIG_LTE_PSM_REQ_RPTAU="00100001"
CONFIG_LTE_PSM_REQ_RAT="00000000"

## eDRX
CONFIG_UDP_EDRX_ENABLE=n

## RAI
# CONFIG_UDP_RAI_ENABLE=y

# Console for user association
CONFIG_CONSOLE_SUBSYS=y
CONFIG_CONSOLE_GETCHAR=y

## Logging
CONFIG_LOG=y
```

## src/main.c
```c
#include <stdio.h>
#include <zephyr/kernel.h>

#include "lte_m_udp_main.h"

K_SEM_DEFINE(modem_shutdown_sem, 0, 1);

int main(void) {
	int err;

	printk("UDP sample has started\n");

	err = nrf_modem_lib_init();
	if (err) {
		printk("Failed to initialize modem library, error: %d\n", err);
		return -1;
	}

	err = lte_m_udp_connect(CONFIG_UDP_SERVER_ADDRESS_STATIC, CONFIG_UDP_SERVER_PORT);
	if (err) {
		return -1;
	}

	char data[] = "this is some test data";
	lte_m_udp_send(data, sizeof(data));

	/*
	this does nothing rn will need to change it so the semaphore is taken when modem is in use and then released when it is done
	so it can be taken here and then the modem can be shutdown
	*/
	k_sem_take(&modem_shutdown_sem, K_FOREVER);

	err = nrf_modem_lib_shutdown();
	if (err) {
		return -1;
	}

	return 0;
}
```

## src/lte_m_udp_connection.c
```c
#include "lte_m_udp_connection.h"
#include <zephyr/logging/log.h>

LOG_MODULE_REGISTER(lte_m_udp_connection);

static int client_fd;
static struct sockaddr_storage host_addr;

K_SEM_DEFINE(lte_connected_sem, 0, 1);

static void lte_m_handler(const struct lte_lc_evt *const evt) {
	switch (evt->type) {
		case LTE_LC_EVT_NW_REG_STATUS:
			if ((evt->nw_reg_status != LTE_LC_NW_REG_REGISTERED_HOME) &&
				(evt->nw_reg_status != LTE_LC_NW_REG_REGISTERED_ROAMING)) {
				break;
			}

			LOG_INF("Network registration status: %s",
				evt->nw_reg_status == LTE_LC_NW_REG_REGISTERED_HOME ?
				"Connected - home" : "Connected - roaming");
			
			//Release semaphore as the lte network is now connected to
			k_sem_give(&lte_connected_sem);
			break;

			case LTE_LC_EVT_PSM_UPDATE:
				LOG_INF("PSM parameter update: TAU: %d s, Active time: %d s",
					evt->psm_cfg.tau, evt->psm_cfg.active_time);
				break;

			case LTE_LC_EVT_EDRX_UPDATE:
				LOG_INF("eDRX parameter update: eDRX: %.2f s, PTW: %.2f s",
					(double)evt->edrx_cfg.edrx, (double)evt->edrx_cfg.ptw);
				break;

			case LTE_LC_EVT_RRC_UPDATE:
				LOG_INF("RRC mode: %s",
					evt->rrc_mode == LTE_LC_RRC_MODE_CONNECTED ? "Connected" : "Idle");
				break;

			case LTE_LC_EVT_CELL_UPDATE:
				LOG_INF("LTE cell changed: Cell ID: %d, Tracking area: %d",
					evt->cell.id, evt->cell.tac);
				break;

			default:
				break;
	}
}

//Connects to server
static int lte_m_udp_socket_connect() {
	int err;

	client_fd = socket(AF_INET, SOCK_DGRAM, IPPROTO_UDP);
	if (client_fd < 0) {
		LOG_ERR("Failed to create UDP socket, error: %d", errno);
		err = -errno;
		return err;
	}

	err = connect(client_fd, (struct sockaddr *)&host_addr, sizeof(struct sockaddr_in));
	if (err < 0) {
		LOG_ERR("Failed to connect socket, error: %d", errno);
		close(client_fd);
		return err;
	}

	return 0;
}

int lte_m_get_client_fd() {
	return client_fd;
}

int lte_m_udp_connect(char *server_ip, int server_port) {
	int err;

	//Connects to lte network
	err = lte_lc_connect_async(lte_m_handler);
	if (err) {
		LOG_ERR("Failed to connect to LTE network, error: %d", err);
		return -1;
	}

	//Wait forever until connected to the lte network before setting up the socket and connecting to it
	k_sem_take(&lte_connected_sem, K_FOREVER);
	
	//Setup the socket
	struct sockaddr_in *server = ((struct sockaddr_in *)&host_addr);

	server->sin_family = AF_INET;
	server->sin_port = htons(server_port);

	inet_pton(AF_INET, server_ip, &server->sin_addr);
	
	//Connect to the socket
	LOG_INF("Conecting to: %s:%d", server_ip, server_port);

	err = lte_m_udp_socket_connect();
	if (err) {
		return -1;
	}

	//No errors
	return 0;
}
```

## src/lte_m_udp_connection.h
```c
#ifndef LTE_M_UDP_CONNECTION_H
#define LTE_M_UDP_CONNECTION_H

#include <zephyr/net/socket.h>
#include <modem/lte_lc.h>
#include <modem/nrf_modem_lib.h>
#include <nrf_modem_at.h>

//Should only be used in the lte_m_udp_send_receive.c file
int lte_m_get_client_fd();

// Connects to lte-m network, sets up socket and then calls lte_m_udp_socket_connect to connect to the socket
int lte_m_udp_connect(char *server_ip, int server_port);

// Connects to the socket specified in lte_m_udp_connect function after lte_m_udp_connect sets up the socket
// static int lte_m_udp_socket_connect()

// Handler function for events relating to the lte-m modem
// static void lte_m_handler(const struct lte_lc_evt *const evt)

#endif
```

## src/lte_m_udp_main.h
```c
#ifndef LTE_M_UDP_MAIN_H
#define LTE_M_UDP_MAIN_H

#include "lte_m_udp_connection.h"
#include "lte_m_udp_send_receive.h"

#endif
```

## src/lte_m_udp_send_receive.c
```c
#include "lte_m_udp_send_receive.h"
#include <zephyr/logging/log.h>

LOG_MODULE_REGISTER(lte_m_udp_send_receive);

void lte_m_udp_send(char *data, int length) {
	int err;

	LOG_INF("Transmitting UDP/IP payload of %d bytes", length + UDP_IP_HEADER_SIZE);

	err = send(lte_m_get_client_fd(), data, length, 0);
	if (err < 0) {
		LOG_ERR("Failed to transmit UDP packet, error: %d", err);
	}
}
```

## src/lte_m_udp_send_receive.h
```c
#ifndef LTE_M_UDP_SEND_RECEIVE_H
#define LTE_M_UDP_SEND_RECEIVE_H

#include <zephyr/net/socket.h>

#include "lte_m_udp_connection.h"

#define UDP_IP_HEADER_SIZE 28

// Sends data to the socket
void lte_m_udp_send(char *data, int length);

#endif
```
